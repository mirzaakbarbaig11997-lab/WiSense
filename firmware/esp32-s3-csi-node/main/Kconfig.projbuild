## firmware/esp32-s3-csi-node/main/Kconfig.projbuild
```kconfig
menu "WiSense CSI Configuration"

    config WISENSE_WIFI_SSID
        string "WiFi SSID"
        default "WiSense_Mesh"
        help
            SSID of the router/AP that the CSI transmitter and receiver are connected to.

    config WISENSE_WIFI_PASSWORD
        string "WiFi Password"
        default "wisense123"
        help
            SSID Password of the router/AP.

    config WISENSE_AGGREGATOR_IP
        string "Aggregator Server IP Address"
        default "192.168.1.10"
        help
            Destination IPv4 address of the WiSense Aggregator listening on UDP port 8082.

endmenu
```

## firmware/esp32-s3-csi-node/sdkconfig.defaults
```kconfig
# WiSense CSI Firmware Defaults
CONFIG_IDF_TARGET="esp32s3"
CONFIG_ESP_DEFAULT_CPU_FREQ_MHZ_240=y
CONFIG_ESP_SYSTEM_PANIC_PRINT_REBOOT=y
CONFIG_ESP32_WIFI_AMPDU_TX_ENABLED=y
CONFIG_ESP32_WIFI_AMPDU_RX_ENABLED=y
CONFIG_ESP32_WIFI_CSI_ENABLED=y
```
